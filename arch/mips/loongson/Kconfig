## arch/mips/loongson/Kconfig
```kconfig
if MACH_LOONGSON

choice
	prompt "Machine Type"

config LEMOTE_FULOONG2E
	bool "Lemote Fuloong(2e) mini-PC"
	select ARCH_SPARSEMEM_ENABLE
	select CEVT_R4K
	select CSRC_R4K
	select SYS_HAS_CPU_LOONGSON2E
	select DMA_NONCOHERENT
	select BOOT_ELF32
	select BOARD_SCACHE
	select HW_HAS_PCI
	select I8259
	select ISA
	select IRQ_CPU
	select SYS_SUPPORTS_32BIT_KERNEL
	select SYS_SUPPORTS_64BIT_KERNEL
	select SYS_SUPPORTS_LITTLE_ENDIAN
	select SYS_SUPPORTS_HIGHMEM
	select SYS_HAS_EARLY_PRINTK
	select GENERIC_ISA_DMA_SUPPORT_BROKEN
	select CPU_HAS_WB
	select LOONGSON_MC146818
	help
	  Lemote Fuloong(2e) mini-PC board based on the Chinese Loongson-2E CPU and
	  an FPGA northbridge

	  Lemote Fuloong(2e) mini PC have a VIA686B south bridge.

config LEMOTE_MACH2F
	bool "Lemote Loongson 2F family machines"
	select ARCH_SPARSEMEM_ENABLE if HIBERNATION
	select BOARD_SCACHE
	select BOOT_ELF32
	select CEVT_R4K if ! MIPS_EXTERNAL_TIMER
	select CPU_HAS_WB
	select CS5536 if PCI
	select CSRC_R4K if ! MIPS_EXTERNAL_TIMER
	select DMA_NONCOHERENT
	select GENERIC_ISA_DMA_SUPPORT_BROKEN
	select HAVE_CLK
	select HW_HAS_PCI
	select I8259
	select IRQ_CPU
	select SYS_HAS_CPU_LOONGSON2F
	select SYS_HAS_EARLY_PRINTK
	select SYS_SUPPORTS_32BIT_KERNEL
	select SYS_SUPPORTS_64BIT_KERNEL
	select SYS_SUPPORTS_HIGHMEM if ! EMBEDDED
	select SYS_SUPPORTS_LITTLE_ENDIAN
	select LOONGSON_MC146818 if RTC_DRV_CMOS
	help
	  Lemote Loongson 2F family machines utilize the 2F revision of
	  Loongson processor and the AMD CS5536 south bridge.

	  These family machines include fuloong2f mini PC, yeeloong2f notebook,
	  LingLoong allinone PC and so forth.

config DEXXON_GDIUM
	bool "Dexxon Gdium Netbook"
	select ARCH_SPARSEMEM_ENABLE
	select BOARD_SCACHE
	select BOOT_ELF32
	select CEVT_R4K if ! MIPS_EXTERNAL_TIMER
	select CPU_HAS_WB
	select CSRC_R4K if ! MIPS_EXTERNAL_TIMER
	select DMA_NONCOHERENT
	select GENERIC_ISA_DMA_SUPPORT_BROKEN
	select HW_HAS_PCI
	select I8259
	select IRQ_CPU
	select ISA
	select SYS_HAS_CPU_LOONGSON2F
	select SYS_HAS_EARLY_PRINTK
	select SYS_SUPPORTS_32BIT_KERNEL
	select SYS_SUPPORTS_64BIT_KERNEL
	select SYS_SUPPORTS_HIGHMEM
	select SYS_SUPPORTS_LITTLE_ENDIAN
	select ARCH_REQUIRE_GPIOLIB
	select HAVE_PWM if MFD_SM501
	help
	  Dexxon gdium netbook based on Loongson 2F and SM502.
endchoice

config CS5536
	select CS5536_IDE if (PATA_AMD || BLK_DEV_AMD74XX || PATA_CS5536)
	select CS5536_OHCI if USB_OHCI_HCD
	select CS5536_EHCI if USB_EHCI_HCD
	select CS5536_AUDIO if SND_CS5535AUDIO
	select CS5536_ISA
	bool

config CS5536_ISA
	select ISA
	bool

config CS5536_IDE
	bool

config CS5536_OHCI
	bool

config CS5536_EHCI
	bool

config CS5536_AUDIO
	bool

config CS5536_MFGPT
	bool "CS5536 MFGPT Timer"
	depends on CS5536
	select MIPS_EXTERNAL_TIMER
	help
	  This option enables the mfgpt0 timer of AMD CS5536.

	  If you want to enable the Loongson2 CPUFreq Driver, Please enable
	  this option at first, otherwise, You will get wrong system time.

	  If unsure, say Yes.

config LOONGSON_SUSPEND
	bool
	default y
	depends on CPU_SUPPORTS_CPUFREQ && SUSPEND

config LOONGSON_MC146818
	bool
	default n

config GDIUM_PWM_CLOCK
	tristate "Gdium PWM Timer"
	default n
	depends on HAVE_PWM && EXPERIMENTAL && BROKEN
	select MIPS_EXTERNAL_TIMER
	help
	  This options enables the experimental sm501-pwm based clock. With it,
	  you may be possible to use the loongson2f cpufreq driver.

config GDIUM_VERSION
	int "Configure Gdium Version"
	depends on DEXXON_GDIUM
	default "3"
	help
	  I have no information about how to determine which version your board
	  is, If the default config doesn't work for it, please change it to
	  smaller ones.
endif # MACH_LOONGSON
```

## drivers/char/kcopy/Kconfig
```kconfig
#
# KCopy character device configuration
#

menu "KCopy"

config KCOPY
   tristate "Memory-to-memory copies using kernel assist"
   default m
   ---help---
     High-performance inter-process memory copies.  Can often save a
     memory copy to shared memory in the application.   Useful at least
     for MPI applications where the point-to-point nature of vmsplice
     and pipes can be a limiting factor in performance.

endmenu
```

## drivers/platform/mips/Kconfig
```kconfig
#
# MIPS Platform Specific Drivers
#

menuconfig MIPS_PLATFORM_DEVICES
	bool "MIPS Platform Specific Device Drivers"
	default y
	help
	  Say Y here to get to see options for device drivers of various
	  MIPS platforms, including vendor-specific netbook/laptop/pc extension
	  drivers.  This option alone does not add any kernel code.

	  If you say N, all options in this submenu will be skipped and disabled.

if MIPS_PLATFORM_DEVICES

config LEMOTE_YEELOONG2F
	tristate "Lemote YeeLoong Laptop"
	depends on LEMOTE_MACH2F
	select BACKLIGHT_LCD_SUPPORT
	select LCD_CLASS_DEVICE
	select BACKLIGHT_CLASS_DEVICE
	select POWER_SUPPLY
	select HWMON
	select VIDEO_OUTPUT_CONTROL
	select INPUT_SPARSEKMAP
	select INPUT_EVDEV
	depends on INPUT
	default m
	help
	  YeeLoong netbook is a mini laptop made by Lemote, which is basically
	  compatible to FuLoong2F mini PC, but it has an extra Embedded
	  Controller(kb3310b) for battery, hotkey, backlight, temperature and
	  fan management.

config LEMOTE_LYNLOONG2F
	tristate "Lemote LynLoong PC"
	depends on LEMOTE_MACH2F
	select BACKLIGHT_LCD_SUPPORT
	select BACKLIGHT_CLASS_DEVICE
	select VIDEO_OUTPUT_CONTROL
	default m
	help
	  LynLoong PC is an AllINONE machine made by Lemote, which is basically
	  compatible to FuLoong2F Mini PC, the only difference is that it has a
	  size-fixed screen: 1360x768 with sisfb video driver. and also, it has
	  its own specific suspend support.

config GDIUM_LAPTOP
	tristate "GDIUM laptop extras"
	depends on DEXXON_GDIUM
	select POWER_SUPPLY
	select I2C
	select INPUT_POLLDEV
	default m
	help
	  This mini-driver drives the ST7 chipset present in the Gdium laptops.
	  This gives battery support, wlan rfkill.

endif # MIPS_PLATFORM_DEVICES
```
